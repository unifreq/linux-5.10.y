## drivers/net/wireless/broadcom/brcm80211/Kconfig.rej
```kconfig
--- drivers/net/wireless/broadcom/brcm80211/Kconfig
+++ drivers/net/wireless/broadcom/brcm80211/Kconfig
@@ -1,6 +1,6 @@
 # SPDX-License-Identifier: GPL-2.0-only
 config BRCMUTIL
-	tristate "Broadcom 802.11 driver utility functions"
+	tristate
 	depends on m
 
 config BRCMSMAC
```

## drivers/net/wireless/mediatek/mt7668sn/Kconfig
```kconfig
config MT7668
        tristate "MediaTek MT7668 (SDIO) support"
        depends on MAC80211
        depends on USB
        depends on MT76_CORE
        help
          This adds support for MT7668-based wireless SDIO.
```

## net/Kconfig.rej
```kconfig
--- net/Kconfig
+++ net/Kconfig
@@ -473,6 +473,3 @@ config HAVE_CBPF_JIT
 # Extended BPF JIT (eBPF)
 config HAVE_EBPF_JIT
 	bool
-
-config SHORTCUT_FE
-	bool "Enables kernel network stack path for Shortcut  Forwarding Engine
```
